/*
 * Lado izquierdo del Corne: nice!view (display SPI).
 * Este override del CS de la nice!view estaba antes en corne.keymap (comun a los
 * dos lados). Se mueve aqui porque el lado derecho ya NO lleva el shield nice_view,
 * y referenciar &nice_view_spi alli romperia la compilacion.
 */

&nice_view_spi {
    cs-gpios = <&pro_micro 8 GPIO_ACTIVE_HIGH>;
};
